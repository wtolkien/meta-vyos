## conf/distro/vyos.conf
```bitbake
# This layer contains kernel patches for a variety of machine-specific
# kernels using .bbappend files in recipes-kernel/linux. To allow image
# building without all machine layers being present, we turn 'dangling
# .bbappend file' errors into warnings
BB_DANGLINGAPPENDS_WARNONLY = "1"

# we install dpkg anyways, might as well use .deb packages instead of the
# default .ipk
PACKAGE_CLASSES = "package_deb"

# VyOS configuration requires fuse filesystem to work, so autoload module on
# system bootup
KERNEL_MODULE_AUTOLOAD += " fuse"

# Disable unnecessary DISTRO_FEATURES and MACHINE_FEATURES here
DISTRO_FEATURES_remove = " \
    alsa \
    bluetooth \
    cramfs \
    directfb \
    irda \
    nfs \
    opengl \
    pcmcia \
    smbfs \
    usbgadget \
    wayland \
    x11 \
    nfc \
    3g \
    "

MACHINE_FEATURES_remove = " \
    alsa \
    bluetooth \
    irda \
    pcmcia \
    phone \
    qvga \
    touchscreen \
    usbgadget \
    "

DISTRO_FEATURES_append = " \
    pam \
    ldap \
    vyos-core \
    vyos-config \
    vyos-net \
    vyos-wlan \
    vyos-routing \
    vyos-wwan \
    vyos-tunnel \
    vyos-vpn \
    vyos-qos \
    vyos-pppoe \
    vyos-dhcp \
    vyos-monitor \
    vyos-firewall \
    vyos-redundancy \
    vyos-proxy \
    vyos-swupdate \
    "

# meta-swupdate is not supported by x86 architecture
X86REMOVE ??= "vyos-swupdate"
DISTRO_FEATURES_remove_qemux86 = "${X86REMOVE}"
DISTRO_FEATURES_remove_qemux86-64 = "${X86REMOVE}"
DISTRO_FEATURES_remove_genericx86 = "${X86REMOVE}"
DISTRO_FEATURES_remove_genericx86-64 = "${X86REMOVE}"

# Image level user/group configuration.
# Inherit extrausers to make the setting of EXTRA_USERS_PARAMS effective.
INHERIT += "extrausers"

EXTRA_USERS_PARAMS = "\
    groupadd -r vyattacfg; \
    groupadd -r vyattaop; \
    groupadd -r quaggavty; \
    groupadd -r fuse; \
    useradd \
        --home /home/vyos \
        --system \
        --gid users \
        --shell /bin/vbash \
        --groups adm,sudo,dip,disk,vyattacfg,quaggavty,fuse \
        --password '' \
        vyos; \
    usermod -P vyos vyos; \
    useradd \
        --home /var/run/quagga \
        --system \
        --user-group \
        --shell /bin/false \
        --comment Vyatta_Quagga_routing_suite \
        --password '' \
        quagga; \
    "

#PREFERRED_PROVIDER_virtual/kernel = "linux-vyos"
PREFERRED_PROVIDER_virtual/kernel_qemux86 = "linux-yocto"
PREFERRED_VERSION_linux-yocto_qemux86 = "4.14%"
```

## conf/layer.conf
```bitbake
# We have a conf and classes directory, append to BBPATH
BBPATH .= ":${LAYERDIR}"

# We have a recipes directory, add to BBFILES
BBFILES += "${LAYERDIR}/recipes*/*/*.bb ${LAYERDIR}/recipes*/*/*.bbappend"

BBFILE_COLLECTIONS += "meta-vyos"
BBFILE_PATTERN_meta-vyos := "^${LAYERDIR}/"
BBFILE_PRIORITY_meta-vyos = "6"

LICENSE_PATH += "${LAYERDIR}/licenses"

LAYERDEPENDS_meta-vyos = "core"
LAYERDEPENDS_meta-vyos += "openembedded-layer"
LAYERDEPENDS_meta-vyos += "networking-layer"
LAYERDEPENDS_meta-vyos += "meta-python"
LAYERDEPENDS_meta-vyos += "perl-layer"
LAYERDEPENDS_meta-vyos += "filesystems-layer"
LAYERDEPENDS_meta-vyos += "swupdate"
```
